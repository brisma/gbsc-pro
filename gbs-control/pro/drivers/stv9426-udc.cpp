#include <string.h>
#include "stv9426-udc.h"

#ifdef ARDUINO
#include <pgmspace.h>
#define STV_PGM PROGMEM
#define STV_RD(p) pgm_read_byte(p)
#else
#define STV_PGM
#define STV_RD(p) (*(p))
#endif

static const char kArt[UDC_COUNT][18][13] STV_PGM = {
    {   // speaker
        "............", "............", ".....#......", "....##...#..", "...###....#.", "######..#..#",
        "######...#.#", "######...#.#", "######...#.#", "######...#.#", "######...#.#", "######..#..#",
        "...###....#.", "....##...#..", ".....#......", "............", "............", "............" },
    {   // muted speaker
        "............", "............", ".....#......", "....##......", "...###......", "######......",
        "######.#...#", "######..#.#.", "######...#..", "######..#.#.", "######.#...#", "######......",
        "...###......", "....##......", ".....#......", "............", "............", "............" },
    {   // check
        "............", "............", "............", "...........#", "..........##", ".........##.",
        "........##..", ".......##...", "#.....##....", "##...##.....", ".##.##......", "..###.......",
        "...#........", "............", "............", "............", "............", "............" },
    {   // lock
        "............", "............", "....####....", "...##..##...", "..##....##..", "..#......#..",
        "..#......#..", ".##########.", ".##########.", ".####..####.", ".####..####.", ".####..####.",
        ".##########.", ".##########.", "............", "............", "............", "............" },
    {   // WiFi
        "............", "............", "............", "...######...", ".##......##.", "#..........#",
        "....####....", "..##....##..", ".#........#.", "....####....", "...#....#...", "............",
        ".....##.....", ".....##.....", "............", "............", "............", "............" },
    {   // sync pulse
        "............", "............", "............", "............", "###......###", "..#......#..",
        "..#......#..", "..#......#..", "..#......#..", "..#......#..", "..#......#..", "..########..",
        "............", "............", "............", "............", "............", "............" },
    {   // monitor
        "............", "............", "############", "#..........#", "#..........#", "#..........#",
        "#..........#", "#..........#", "#..........#", "#..........#", "############", ".....##.....",
        ".....##.....", "...######...", "............", "............", "............", "............" },
    {   // slider full
        "............", "............", "............", "............", "............", "............",
        "############", "############", "############", "############", "############", "############",
        "............", "............", "............", "............", "............", "............" },
    {   // slider half
        "............", "............", "............", "............", "............", "............",
        "######......", "######......", "############", "############", "######......", "######......",
        "............", "............", "............", "............", "............", "............" },
    {   // slider track
        "............", "............", "............", "............", "............", "............",
        "............", "............", "############", "############", "............", "............",
        "............", "............", "............", "............", "............", "............" },
    {   // percent sign (the ROM has none): rows 4..15, 2-pixel strokes, like the ROM digits
        "............", "............", "............", "............", ".###......#.", "##.##....##.",
        "##.##...##..", ".###...##...", "......##....", ".....##.....", "....##......", "...##.......",
        "..##...###..", ".##...##.##.", "##....##.##.", "#......###..", "............", "............" },
    {   // chevron left (no box, unlike ROM 0x05)
        "............", "............", "............", "............", "......##....", ".....##.....",
        "....##......", "...##.......", "..##........", "...##.......", "....##......", ".....##.....",
        "......##....", "............", "............", "............", "............", "............" },
    {   // chevron right (ROM 0x15 has a box)
        "............", "............", "............", "............", "....##......", ".....##.....",
        "......##....", ".......##...", "........##..", ".......##...", "......##....", ".....##.....",
        "....##......", "............", "............", "............", "............", "............" },
    {   // chevron up
        "............", "............", "............", "............", "............", "............",
        "......#.....", ".....###....", "....##.##...", "...##...##..", "..##.....##.", "..#.......#.",
        "............", "............", "............", "............", "............", "............" },
    {   // chevron down
        "............", "............", "............", "............", "............", "............",
        "..#.......#.", "..##.....##.", "...##...##..", "....##.##...", ".....###....", "......#.....",
        "............", "............", "............", "............", "............", "............" },
    {   // scrollbar track: 2-pixel line on the right of the cell, rows join when stacked
        "........##..", "........##..", "........##..", "........##..", "........##..", "........##..",
        "........##..", "........##..", "........##..", "........##..", "........##..", "........##..",
        "........##..", "........##..", "........##..", "........##..", "........##..", "........##.." },
    {   // scrollbar thumb: 6-pixel block, centred on the track
        "......######", "......######", "......######", "......######", "......######", "......######",
        "......######", "......######", "......######", "......######", "......######", "......######",
        "......######", "......######", "......######", "......######", "......######", "......######" },
    {   // question mark (the ROM has none): rows 4..15, 2-pixel strokes, like the percent sign
        "............", "............", "............", "............", "...######...", "..##....##..",
        "..##....##..", "........##..", ".......##...", "......##....", ".....##.....", ".....##.....",
        ".....##.....", "............", ".....##.....", ".....##.....", "............", "............" },
    {   // comma (the ROM has none): the question mark's 2 x 2 dot (rows 14..15) with a tail down to the left
        "............", "............", "............", "............", "............", "............",
        "............", "............", "............", "............", "............", "............",
        "............", "............", ".....##.....", ".....##.....", "......#.....", ".....#......" },
};

void stvUdcBytes(uint8_t n, uint8_t out[38]) {
    memset(out, 0, 38);
    if (n >= UDC_COUNT) return;
    for (uint8_t s = 0; s < 18; s++) {
        uint16_t v = 0;
        for (uint8_t x = 0; x < 12; x++)
            if (STV_RD(&kArt[n][s][x]) == '#') v |= (uint16_t)(1u << (11 - x));
        out[2 * s] = (uint8_t)(v & 0xFF);
        out[2 * s + 1] = (uint8_t)((v >> 8) & 0x0F);
    }
    out[36] = out[34];   // slice 18 = slice 17: the slice interpolator shows it on a strip's last line when CH > 18
    out[37] = out[35];
}
